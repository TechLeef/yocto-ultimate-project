## meta-techleef-bsp/conf/layer.conf
```bitbake
# We have a conf and classes directory, add to BBPATH
BBPATH .= ":${LAYERDIR}"

# We have recipes-* directories, add to BBFILES
BBFILES += "${LAYERDIR}/recipes-*/*/*.bb \
            ${LAYERDIR}/recipes-*/*/*.bbappend"

BBFILE_COLLECTIONS += "meta-techleef-bsp"
BBFILE_PATTERN_meta-techleef-bsp = "^${LAYERDIR}/"
BBFILE_PRIORITY_meta-techleef-bsp = "6"

LAYERDEPENDS_meta-techleef-bsp = "core"
LAYERSERIES_COMPAT_meta-techleef-bsp = "scarthgap"
```

## meta-techleef-distro/conf/layer.conf
```bitbake
# We have a conf and classes directory, add to BBPATH
BBPATH .= ":${LAYERDIR}"

# We have recipes-* directories, add to BBFILES
BBFILES += "${LAYERDIR}/recipes-*/*/*.bb \
            ${LAYERDIR}/recipes-*/*/*.bbappend"

BBFILE_COLLECTIONS += "meta-techleef-distro"
BBFILE_PATTERN_meta-techleef-distro = "^${LAYERDIR}/"
BBFILE_PRIORITY_meta-techleef-distro = "6"

LAYERDEPENDS_meta-techleef-distro = "core"
LAYERSERIES_COMPAT_meta-techleef-distro = "scarthgap"
```

## meta-techleef/conf/layer.conf
```bitbake
# We have a conf and classes directory, add to BBPATH
BBPATH .= ":${LAYERDIR}"

# We have recipes-* directories, add to BBFILES
BBFILES += "${LAYERDIR}/recipes-*/*/*.bb \
            ${LAYERDIR}/recipes-*/*/*.bbappend"

BBFILE_COLLECTIONS += "meta-techleef"
BBFILE_PATTERN_meta-techleef = "^${LAYERDIR}/"
BBFILE_PRIORITY_meta-techleef = "6"

LAYERDEPENDS_meta-techleef = "core"
LAYERSERIES_COMPAT_meta-techleef = "scarthgap"
```
