## meta-techleef-bsp/conf/machine/techleef-rpi02w64.conf
```bitbake
require conf/machine/raspberrypi0-2w-64.conf

MACHINE_FEATURES = ""
MACHINE_EXTRA_RDEPENDS = ""
MACHINE_EXTRA_RRECOMMENDS = ""

RPI_USE_U_BOOT = "1"
ENABLE_I2C = "1"
ENABLE_UART = "1"

KERNEL_DEVICETREE = "\
    broadcom/bcm2710-rpi-zero-2.dtb \
    overlays/overlay_map.dtb \
"
```

## meta-techleef-distro/conf/distro/techleef.conf
```bitbake
DISTRO = "techleef"
DISTRO_NAME = "TechLeef Distribution"
DISTRO_VERSION = "1.0"
DISTRO_CODENAME = "best"

INIT_MANAGER = "systemd"

TCLIBCAPPEND = ""

DISTRO_FEATURES = "\
    ipv4 \
    ipv6 \
    ldconfig \
    usbgadget \
    usbhost \
    usrmerge \
    vfat \
    wifi \
"

NO_RECOMMENDATIONS = "1"
DISTRO_EXTRA_RDEPENDS = ""
DISTRO_EXTRA_RRECOMMENDS = ""

include recipes-kernel/linux/cve-exclusion.inc
include recipes-kernel/linux/cve-exclusion_6.6.inc
include conf/distro/include/cve-extra-exclusions.inc
#INHERIT += "cve-check"


INHERIT += "create-spdx"
SPDX_PRETTY = "1"
```
